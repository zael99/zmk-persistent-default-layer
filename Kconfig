## Kconfig
```kconfig
menuconfig ZMK_BEHAVIOR_PDF
	bool "Enable Persistent Default Layer (PDF) Behavior"
	help
	  Enable the pdf (persistent default layer) behavior which switches layers and persists
	  the active layer to settings, restoring it on boot. This mimics the
	  QMK PDF (Persistent Default Layer) function.

if ZMK_BEHAVIOR_PDF

config ZMK_BEHAVIOR_PDF
	select SETTINGS
	select NVS
endif # ZMK_BEHAVIOR_PDF
```

## dts/bindings/behaviors/zmk,behavior-default-layer.yaml
```yaml
# Copyright (c) 2024 ZMK Contributors
# SPDX-License-Identifier: MIT

description: >-
  Default Layer Behavior allows changing the active layer and persists
  the selection to the keyboard's settings, restoring it on boot.
  Similar to QMK's PDF (Persistent Default Layer) function.

compatible: "zmk,behavior-default-layer"

include: [base.yaml]

properties:
  default-layer:
    type: int
    required: false
    default: 0
    description: |
      The layer to activate on module initialization if no layer has been
      saved in settings yet. This should be a valid layer number (0-based).
```

## dts/bindings/behaviors/zmk,behaviour-layer-info.yaml
```yaml
# Copyright (c) 2024 ZMK Contributors
# SPDX-License-Identifier: MIT

description: Layer Info Output Behavior

compatible: "zmk,behaviour-layer-info"

include: base.yaml
```

## dts/bindings/behaviors/zmk,behaviour-persistent-default-layer.yaml
```yaml
# Copyright (c) 2024 ZMK Contributors
# SPDX-License-Identifier: MIT
description: RGB Extended

compatible: "zmk,behaviour-persistent-default-layer"

include: one_param.yaml

properties:
  default-layer:
    type: int
    required: false
    default: 0
    description: |
      The layer to activate on module initialization if no layer has been
      saved in settings yet. This should be a valid layer number (0-based).
```
