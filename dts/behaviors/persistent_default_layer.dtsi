/*
 * Copyright (c) 2020 The ZMK Contributors
 *
 * SPDX-License-Identifier: MIT
 */

/ {
    behaviors {
        pdf: pdf {
            compatible = "zmk,behaviour-persistent-default-layer";
            #binding-cells = <1>;
            default-layer = <0>;
        };

        layer_info: layer_info {
            compatible = "zmk,behaviour-layer-info";
            #binding-cells = <0>;
        };
    };
};
